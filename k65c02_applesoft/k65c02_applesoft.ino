////////////////////////////////////////////////////////////////////
// RetroShield 6502 for Arduino Mega
// Apple I
//
// 2019/01/28
// Version 0.1

// The MIT License (MIT)

// Copyright (c) 2019 Erturk Kocalar, 8Bitforce.com

// Permission is hereby granted, free of charge, to any person obtaining a copy
// of this software and associated documentation files (the "Software"), to deal
// in the Software without restriction, including without limitation the rights
// to use, copy, modify, merge, publish, distribute, sublicense, and/or sell
// copies of the Software, and to permit persons to whom the Software is
// furnished to do so, subject to the following conditions:

// The above copyright notice and this permission notice shall be included in all
// copies or substantial portions of the Software.

// THE SOFTWARE IS PROVIDED "AS IS", WITHOUT WARRANTY OF ANY KIND, EXPRESS OR
// IMPLIED, INCLUDING BUT NOT LIMITED TO THE WARRANTIES OF MERCHANTABILITY,
// FITNESS FOR A PARTICULAR PURPOSE AND NONINFRINGEMENT. IN NO EVENT SHALL THE
// AUTHORS OR COPYRIGHT HOLDERS BE LIABLE FOR ANY CLAIM, DAMAGES OR OTHER
// LIABILITY, WHETHER IN AN ACTION OF CONTRACT, TORT OR OTHERWISE, ARISING FROM,
// OUT OF OR IN CONNECTION WITH THE SOFTWARE OR THE USE OR OTHER DEALINGS IN THE
// SOFTWARE.

////////////////////////////////////////////////////////////////////
// Options
//   USE_SPI_RAM: Enable Microchip 128KB SPI-RAM  (Details coming up)
//   USE_LCD_KEYPAD: Enable LCD/Keyboard Shield
//   outputDEBUG: Print memory access debugging messages.
////////////////////////////////////////////////////////////////////
#define USE_SPI_RAM     0
#define USE_LCD_KEYPAD  0
#define outputDEBUG     0

////////////////////////////////////////////////////////////////////
// include the library code for LCD shield:
////////////////////////////////////////////////////////////////////
#include <avr/pgmspace.h>


////////////////////////////////////////////////////////////////////
// SPI FUNCTIONS
//
// 23L1024 SPI RAM (128K)
// $00000 - $1FFFF
////////////////////////////////////////////////////////////////////
#if (USE_SPI_RAM)

#include "pins2_arduino.h"
#include <DIO2.h>

GPIO_pin_t LED1          = DPA4;
GPIO_pin_t LED2          = DPA5;

GPIO_pin_t PIN_SIO3      = DPA3;
GPIO_pin_t PIN_SIO2      = DPA2;
GPIO_pin_t PIN_SIO1      = DPA1;
GPIO_pin_t PIN_SIO0      = DPA0;
GPIO_pin_t PIN_HOLD      = DP7;
GPIO_pin_t PIN_SCK       = DP6;
GPIO_pin_t PIN_SI        = DP5;
GPIO_pin_t PIN_SO        = DP3;
GPIO_pin_t PIN_CS        = DP2;

inline __attribute__((always_inline))
void spi_reset()
{
  digitalWrite2f(PIN_CS, LOW);
  spi_send(0xFF);
  digitalWrite2f(PIN_CS, HIGH);
}

inline __attribute__((always_inline))
byte spi_get_mode()
{
  byte mode;
  
  digitalWrite2f(PIN_CS, LOW);
  spi_send(0x05);
  mode = spi_receive();
  digitalWrite2f(PIN_CS, HIGH);
  return mode;
}

inline __attribute__((always_inline))
byte spi_set_mode(byte mode)
{
  digitalWrite2f(PIN_CS, LOW);
  spi_send(0x01);
  spi_send(mode);
  digitalWrite2f(PIN_CS, HIGH);
  return mode;
}

inline __attribute__((always_inline))
byte spi_get_mode_quad()
{
  byte mode;
  
  digitalWrite2f(PIN_CS, LOW);
  spi_send_quad(0x05);
  mode = spi_receive_quad();
  digitalWrite2f(PIN_CS, HIGH);
  return mode;
}

inline __attribute__((always_inline))
void spi_enter_quad()
{
  digitalWrite2f(PIN_CS, LOW);
  spi_send(0x38);
  digitalWrite2f(PIN_CS, HIGH);
  pinMode2f(PIN_SI, INPUT_PULLUP);
}

inline __attribute__((always_inline))
void spi_exit_quad()
{
  digitalWrite2f(PIN_CS, LOW);
  spi_send(0xFF);
  digitalWrite2f(PIN_CS, HIGH);
  pinMode2f(PIN_SI, OUTPUT);  digitalWrite2f(PIN_SI, LOW);
}

inline __attribute__((always_inline))
void spi_init()
{
  pinMode2f(PIN_CS,   OUTPUT);  digitalWrite2f(PIN_CS, HIGH);
  pinMode2f(PIN_SCK,  OUTPUT);  digitalWrite2f(PIN_SCK,  LOW);
  pinMode2f(PIN_HOLD, INPUT_PULLUP);
  pinMode2f(PIN_SI,   OUTPUT);  digitalWrite2f(PIN_SI, LOW);
  pinMode2f(PIN_SO,   INPUT_PULLUP);
  pinMode2f(PIN_SIO0, INPUT_PULLUP);
  pinMode2f(PIN_SIO1, INPUT_PULLUP);
  pinMode2f(PIN_SIO2, INPUT_PULLUP);
  pinMode2f(PIN_SIO3, INPUT_PULLUP);

  pinMode2f(LED1, OUTPUT);      digitalWrite2f(LED1, LOW);
  pinMode2f(LED2, OUTPUT);      digitalWrite2f(LED2, HIGH);

  spi_reset();
  spi_set_mode(0x40);   // sequantial mode

  spi_enter_quad();
  Serial.print("\nSPI-RAM -   Quad Mode: ");
  Serial.println(spi_get_mode_quad(), HEX);    
}

inline __attribute__((always_inline))
void spi_send(byte working)         // function to actually bit shift the data byte out
{
  pinMode2f(PIN_SI,   OUTPUT);
  digitalWrite2f(PIN_SI,   LOW);

  for(int i = 1; i <= 8; i++)         // setup a loop of 8 iterations, one for each bit
  {                                         
      if (working > 127)              // test the most significant bit
      { 
          digitalWrite2f(PIN_SI,HIGH);   // if it is a 1 (ie. B1XXXXXXX), set the master out pin high
          // digitalWrite2f(LED2, HIGH);
      } else {
          digitalWrite2f(PIN_SI, LOW);   // if it is not 1 (ie. B0XXXXXXX), set the master out pin low
          // digitalWrite2f(LED2, LOW);
      }
      digitalWrite2f(PIN_SCK,HIGH);        // set clock high, the pot IC will read the bit into its register
      // digitalWrite2f(LED1, HIGH);
      working = working << 1;
      // delay(500);
      digitalWrite2f(PIN_SCK,LOW);          // set clock low, the pot IC will stop reading and prepare for the next iteration (next significant bit
      // digitalWrite2f(LED1, LOW);
      // delay(500);
  }
  pinMode2f(PIN_SI,   INPUT_PULLUP);
}

inline __attribute__((always_inline))
byte spi_receive()
{
  byte din = 0;
  
  for(int i = 1; i <= 8; i++)         // setup a loop of 8 iterations, one for each bit
  {                   
    din = din << 1;                      
    digitalWrite2f (PIN_SCK,HIGH);        // set clock high, the pot IC will read the bit into its register
    if (digitalRead2f(PIN_SO))
      din = din | 1;
    digitalWrite2f(PIN_SCK,LOW);          // set clock low, the pot IC will stop reading and prepare for the next iteration (next significant bit
  }
  return(din);
}

inline __attribute__((always_inline))
void spi_write_byte(byte bank, word addr, byte data)
{
  byte hh = (addr & 0xFF00) >> 8;
  byte ll = addr & 0xFF;
  
  digitalWrite2f(PIN_CS, LOW);
  spi_send(0x02);
  spi_send(bank & 0x01);
  spi_send(hh);
  spi_send(ll);
  spi_send(data);    
  digitalWrite2f(PIN_CS, HIGH);    
}

inline __attribute__((always_inline))
byte spi_read_byte(byte bank, word addr)
{
  byte hh = (addr & 0xFF00) >> 8;
  byte ll = addr & 0xFF;
  byte data;
  
  digitalWrite2f(PIN_CS, LOW);
  spi_send(0x03);
  spi_send(bank & 0x01);
  spi_send(hh);
  spi_send(ll);
  data = spi_receive();    
  digitalWrite2f(PIN_CS, HIGH);
  return data;
}

inline __attribute__((always_inline))
byte spi_read_byte_quad(byte bank, word addr)
{
  byte hh = (addr & 0xFF00) >> 8;
  byte ll = addr & 0xFF;
  byte data;

  digitalWrite2f(PIN_CS, LOW);
  spi_send_quad(0x03);
  spi_send_quad(bank & 0x01);
  spi_send_quad(hh);
  spi_send_quad(ll);
  /* dummy read */ spi_receive_quad();
  data = spi_receive_quad();
  digitalWrite2f(PIN_CS, HIGH);

  // Serial.print("SPI_Read: "); Serial.print(data, HEX); Serial.print(" <- "); Serial.println(addr, HEX);
  return data;
}

inline __attribute__((always_inline))
void spi_write_byte_quad(byte bank, word addr, byte data)
{
  byte hh = (addr & 0xFF00) >> 8;
  byte ll = addr & 0xFF;

  // Serial.print("SPI_Write: "); Serial.print(data, HEX); Serial.print(" -> "); Serial.println(addr, HEX);

  digitalWrite2f(PIN_CS, LOW);
  spi_send_quad(0x02);
  spi_send_quad(bank & 0x01);
  spi_send_quad(hh);
  spi_send_quad(ll);
  spi_send_quad(data);
  digitalWrite2f(PIN_CS, HIGH);
}

inline __attribute__((always_inline))
void spi_read_byte_array_quad(byte bank, word addr, word cnt, byte *ptr)
{
  byte hh = (addr & 0xFF00) >> 8;
  byte ll = addr & 0xFF;
  byte data;
  
  digitalWrite2f(PIN_CS, LOW);
  spi_send_quad(0x03);
  spi_send_quad(bank & 0x01);
  spi_send_quad(hh);
  spi_send_quad(ll);
  /* dummy read */ spi_receive_quad();
  while (cnt--) 
    *ptr++ = spi_receive_quad();
  digitalWrite2f(PIN_CS, HIGH);
}

inline __attribute__((always_inline))
void spi_write_byte_array_quad(byte bank, word addr, word cnt, byte *ptr)
{
  byte hh = (addr & 0xFF00) >> 8;
  byte ll = addr & 0xFF;
  
  digitalWrite2f(PIN_CS, LOW);
  spi_send_quad(0x02);
  spi_send_quad(bank & 0x01);
  spi_send_quad(hh);
  spi_send_quad(ll);
  while (cnt--)
  {
    Serial.print("+"); Serial.print(*ptr, HEX); 
    spi_send_quad(*ptr++);
  }
  Serial.println("");
  digitalWrite2f(PIN_CS, HIGH);
}

inline __attribute__((always_inline))
void spi_send_quad(byte working)         // Quad mode
{
  byte hh = (working & 0xF0) >> 4;
  byte ll = (working & 0x0F);

  // digitalWrite2f(LED1, HIGH);

  pinMode2f(PIN_SIO0, OUTPUT);
  pinMode2f(PIN_SIO1, OUTPUT);
  pinMode2f(PIN_SIO2, OUTPUT);
  pinMode2f(PIN_SIO3, OUTPUT);

  PORTF = (PINF & 0xF0) | hh; 

  digitalWrite2f(PIN_SCK,HIGH);
  digitalWrite2f(PIN_SCK,LOW);

  PORTF = (PINF & 0xF0) | ll; 

  digitalWrite2f(PIN_SCK,HIGH);
  digitalWrite2f(PIN_SCK,LOW);

  pinMode2f(PIN_SIO0, INPUT_PULLUP);
  pinMode2f(PIN_SIO1, INPUT_PULLUP);
  pinMode2f(PIN_SIO2, INPUT_PULLUP);
  pinMode2f(PIN_SIO3, INPUT_PULLUP);

  // digitalWrite2f(LED1, LOW);
}

inline __attribute__((always_inline))
word spi_receive_quad()         // Quad mode
{
  byte b = 0;

  // digitalWrite2f(LED2, HIGH);

  digitalWrite2f(PIN_SCK, HIGH);     
  b = (PINF & 0x0F) << 4;
  digitalWrite2f(PIN_SCK,LOW);
  digitalWrite2f(PIN_SCK,HIGH);
  b = b | (PINF & 0x0F);
  digitalWrite2f(PIN_SCK,LOW);

  // digitalWrite2f(LED2, LOW);

  return(b);
}


////////////////////////////////////////////////////////////////////
// Cache for SPI-RAM
////////////////////////////////////////////////////////////////////

byte cachePage[16];
byte cacheRAM[16][256];

inline __attribute__((always_inline))
byte cache_read_byte(word addr)           // 0x1234
{
//  byte p = (addr & 0xFF00) >> 8;          // p = 0x12
//  byte a = addr & 0x00FF;                 // a = 0x34
//  byte n = a >> 4;                        // n = 0x03
//  byte r = a & 0x0F;                      // r = 0x04

  byte a = (addr & 0xFF00) >> 8;            // a = 0x12
  byte p = a >> 4;                          // p = 0x01
  byte n = a & 0x0F;                        // n = 0x02
  byte r = (addr & 0x00FF);                 // r = 0x34
  
  // Serial.print("cache addr: "); Serial.print(addr, HEX);

  if (cachePage[n] == p)
  {
    // Cache Hit !!!
    return cacheRAM[n][r];
  }
  else
  {
    // Need to fill cache from SPI-RAM
    digitalWrite2f(LED2, HIGH);
    spi_read_byte_array_quad(0, addr & 0xFF00, 256, cacheRAM[n]);
    cachePage[n] = p;
    digitalWrite2f(LED2, LOW);
    return cacheRAM[n][r];
  }
}

inline __attribute__((always_inline))
void cache_write_byte(word addr, byte din)   // 0x1234
{
//  byte p = (addr & 0xFF00) >> 8;          // p = 0x12
//  byte a = addr & 0x00FF;                 // a = 0x34
//  byte n = a >> 4;                        // n = 0x03
//  byte r = a & 0x0f;                      // r = 0x04

  byte a = (addr & 0xFF00) >> 8;            // a = 0x12
  byte p = a >> 4;                          // p = 0x01
  byte n = a & 0x0F;                        // n = 0x02
  byte r = (addr & 0x00FF);                 // r = 0x34

  
  if (cachePage[n] == p)
  {
    // Cache Hit !!!
    cacheRAM[n][r] = din;
    spi_write_byte_quad(0, addr, din);        // Write-thru cache :)
    return;
  }
  else
  {
    // Need to fill cache from SPI-RAM
    digitalWrite2f(LED1, HIGH);
    spi_write_byte_quad(0, addr, din);
    spi_read_byte_array_quad(0, addr & 0xFF00, 256, cacheRAM[n]);
    cachePage[n] = p;
    digitalWrite2f(LED1, LOW);
    return;
  }
}

void cache_init()
{
  // Initialize cache from spi-ram
  for(int p=0; p<16; p++)
  {
    cachePage[p] = 0;
  }
  Serial.println("RAM Cache - Initialized.");

}

#endif


////////////////////////////////////////////////////////////////////
// Configuration
////////////////////////////////////////////////////////////////////
#if USE_LCD_KEYPAD

#include <LiquidCrystal.h>

  /*
    The circuit:
   * LCD RS pin to digital pin 12
   * LCD Enable pin to digital pin 11
   * LCD D4 pin to digital pin 5
   * LCD D5 pin to digital pin 4
   * LCD D6 pin to digital pin 3
   * LCD D7 pin to digital pin 2
   * LCD R/W pin to ground
   * 10K resistor:
   * ends to +5V and ground
   * wiper to LCD VO pin (pin 3)
  */

  #define LCD_RS  8
  #define LCD_EN  9
  #define LCD_D4  4
  #define LCD_D5  5
  #define LCD_D6  6
  #define LCD_D7  7
  #define LCD_BL  10
  #define LCD_BTN  0
  
  #define NUM_KEYS   5
  #define BTN_DEBOUNCE 10
  #define BTN_RIGHT  0
  #define BTN_UP     1
  #define BTN_DOWN   2
  #define BTN_LEFT   3
  #define BTN_SELECT 4
  const int adc_key_val[NUM_KEYS] = { 30, 180, 360, 535, 760 };
  int       key = -1;
  int       oldkey = -1;
  boolean   BTN_PRESS = 0;
  boolean   BTN_RELEASE = 0;

  LiquidCrystal lcd(LCD_RS, LCD_EN, LCD_D4, LCD_D5, LCD_D6, LCD_D7);
  int backlightSet = 25;
#endif



////////////////////////////////////////////////////////////////////
// 65C02 DEFINITIONS
////////////////////////////////////////////////////////////////////

// 65C02 HW CONSTRAINTS
// 1- RESET_N must be asserted at least 2 clock cycles.
// 2- CLK can not be low more than 5 microseconds.  Can be high indefinitely.
//

// MEMORY LAYOUT
// - Apple 1 BASIC requires 4KB min, so adjust when SPI_RAM not used.
#if (USE_SPI_RAM)
  // 2K MEMORY
  #define RAM_START   0x0000
  #define RAM_END     0x07FF
  byte    RAM[RAM_END-RAM_START+1];
#else
  // 2K MEMORY
  #define RAM_START   0x0000
  #define RAM_END     0x17FF
  byte    RAM[RAM_END-RAM_START+1];
#endif

// ROMs (Monitor + Basic)
#define ROM_START   0xFF00
#define ROM_END     0xFFFF
#define BASIC_START 0x6000
#define BASIC_END   0x7FFF

////////////////////////////////////////////////////////////////////
// Woz Monitor Code
////////////////////////////////////////////////////////////////////
// static const unsigned char 
PROGMEM const unsigned char rom_bin[] = {
// static const unsigned char rom_bin[] = {
    0xd8, 0x58, 0xa0, 0x7f, 0x8c, 0x12, 0xd0, 0xa9, 0xa7, 0x8d, 0x11, 0xd0, 
    0x8d, 0x13, 0xd0, 0xc9, 0xdf, 0xf0, 0x13, 0xc9, 0x9b, 0xf0, 0x03, 0xc8, 
    0x10, 0x0f, 0xa9, 0xdc, 0x20, 0xef, 0xff, 0xa9, 0x8d, 0x20, 0xef, 0xff, 
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    0x00, 0xff, 0x00, 0x00
};

// BASIC ROM starts at E000
// Dump from: http://www.brielcomputers.com/basic_dump.txt

//lyh Applesoft 6000R
PROGMEM const unsigned char basic_bin[] = {0x4c,0xa5,0x7c,0x4c,0xea,0x62,0xcd,0x66,0xdb,0x65,0xa8,0x6a,0x90,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0xf9,0x60};

////////////////////////////////////////////////////////////////////
// 6821 Peripheral
// emulate just enough so keyboard/display works thru serial port.
////////////////////////////////////////////////////////////////////
//

#define KBD   0xd010
#define KBDCR 0xd011
#define DSP   0xd012
#define DSPCR 0xd013
byte regKBD;
byte regKBDDIR;    // Dir register when KBDCR.bit2 == 0
byte regKBDCR;
byte regDSP;
byte regDSPDIR;    // Dir register when DSPCR.bit2 == 0
byte regDSPCR;


////////////////////////////////////////////////////////////////////
// 65c02 Processor Control
////////////////////////////////////////////////////////////////////
//

/* Digital Pin Assignments */
#define DATA_OUT PORTL
#define DATA_IN  PINL
#define ADDR_H   PINC
#define ADDR_L   PINA
#define ADDR     ((unsigned int) (ADDR_H << 8 | ADDR_L))

#define uP_RESET_N  38
#define uP_RW_N     40
#define uP_RDY      39
#define uP_SO_N     41
#define uP_IRQ_N    50
#define uP_NMI_N    51
#define uP_E        52
#define uP_GPIO     53

// Fast routines to drive clock signals high/low; faster than digitalWrite
// required to meet >100kHz clock freq for 6809e.
// 6502 & z80 do not have this requirement.
//
#define CLK_Q_HIGH  (PORTB = PORTB | 0x01)
#define CLK_Q_LOW   (PORTB = PORTB & 0xFE)
#define CLK_E_HIGH  (PORTB = PORTB | 0x02)
#define CLK_E_LOW   (PORTB = PORTB & 0xFC)
#define STATE_RW_N  (PING & 0x02)

#define DIR_IN  0x00
#define DIR_OUT 0xFF
#define DATA_DIR   DDRL
#define ADDR_H_DIR DDRC
#define ADDR_L_DIR DDRA

unsigned long clock_cycle_count;
unsigned long clock_cycle_last;
unsigned long uP_start_millis;
unsigned long uP_stop_millis;
unsigned long uP_millis_last;
unsigned int  uP_ADDR;
byte uP_DATA;

void uP_assert_reset()
{
  // Drive RESET conditions
  digitalWrite(uP_RESET_N, LOW);
  digitalWrite(uP_IRQ_N, HIGH);
  digitalWrite(uP_NMI_N, HIGH);
  digitalWrite(uP_RDY, HIGH);
  digitalWrite(uP_SO_N, HIGH);
}

void uP_release_reset()
{
  // Drive RESET conditions
  digitalWrite(uP_RESET_N, HIGH);
}

void uP_init()
{
  // Set directions
  DATA_DIR = DIR_IN;
  ADDR_H_DIR = DIR_IN;
  ADDR_L_DIR = DIR_IN;
  pinMode(uP_RESET_N, OUTPUT);
  pinMode(uP_RW_N,    INPUT);
  pinMode(uP_RDY,     OUTPUT);
  pinMode(uP_SO_N,    OUTPUT);
  pinMode(uP_IRQ_N,   OUTPUT);
  pinMode(uP_NMI_N,   OUTPUT);
  pinMode(uP_E,       OUTPUT);
  pinMode(uP_GPIO,    OUTPUT);
  
  uP_assert_reset();
  digitalWrite(uP_E, LOW);
  digitalWrite(uP_GPIO, LOW);
  
  clock_cycle_count = 0;
  clock_cycle_last  = 0;
  uP_start_millis = millis();
}

void m6821_init()
{
  regKBD    = 0x00;
  regKBDDIR = 0x00;
  regKBDCR  = 0x00;
  regDSP    = 0x00;
  regDSPDIR = 0x00;
  regDSPCR  = 0x00;
}

////////////////////////////////////////////////////////////////////
// Processor Control Loop
////////////////////////////////////////////////////////////////////
// This is where the action is.
// it reads processor control signals and acts accordingly.
//

inline __attribute__((always_inline))
void cpu_tick()
{ 
  int ch;
  
  CLK_E_HIGH;    // E goes high   // digitalWrite(uP_E, HIGH);
  
  uP_ADDR = ADDR;
    
  if (STATE_RW_N)	  
  //////////////////////////////////////////////////////////////////
  // HIGH = READ
  {
    // change DATA port to output to uP:
    DATA_DIR = DIR_OUT;
    
    // ROM?
    if ( (ROM_START <= uP_ADDR) && (uP_ADDR <= ROM_END) )
      DATA_OUT = pgm_read_byte_near(rom_bin + (uP_ADDR - ROM_START));
    else
    if ( (BASIC_START <= uP_ADDR) && (uP_ADDR <= BASIC_END) )
      DATA_OUT = pgm_read_byte_near(basic_bin + (uP_ADDR - BASIC_START));
    else
    // RAM?
    if ( (uP_ADDR <= RAM_END) && (RAM_START <= uP_ADDR) )
      // Use Arduino RAM for stack/important stuff
      DATA_OUT = RAM[uP_ADDR - RAM_START];
    else
    // 6821?
    if ( KBD <=uP_ADDR && uP_ADDR <= DSPCR )   
    {      
      // KBD?
      if (uP_ADDR == KBD)
      {
        if (regKBDCR & 0x02)
          // KBD register  
          {
            DATA_OUT = regKBD;
            regKBDCR = regKBDCR & 0x7F;    // clear IRQA bit upon read
          }
        else
          DATA_OUT = regKBDDIR;
      }
      else
      // KBDCR?
      if (uP_ADDR == KBDCR)
      {
        // KBDCR register
        DATA_OUT = regKBDCR;  
      }
      else
      // DSP?
      if (uP_ADDR == DSP)
      {
        if (regDSPCR & 0x02) 
          // DSP register  
          {
            DATA_OUT = regDSP;
            regDSPCR = regDSPCR & 0x7F;    // clear IRQA bit upon read
          }
        else
          DATA_OUT = regDSPDIR;
      }
      else
      // DSPCR?
      if (uP_ADDR == DSPCR)
      {
        // DSPCR register
        DATA_OUT = regDSPCR;  
      }   
      
    }
#if (USE_SPI_RAM)
    else
    {
      //treat everywhere else as ram
      DATA_OUT = cache_read_byte(uP_ADDR);
      // DATA_OUT = spi_read_byte_quad(0, uP_ADDR);
    }
#endif

#if outputDEBUG
//    if (outputDEBUG)
//    {
      char tmp[20];
      sprintf(tmp, "-- A=%0.4X D=%0.2X\n", uP_ADDR, DATA_OUT);
      Serial.write(tmp);
//    }
#endif

  } 
  else 
  //////////////////////////////////////////////////////////////////
  // R/W = LOW = WRITE
  {
    // RAM?
    if ( (uP_ADDR <= RAM_END) && (RAM_START <= uP_ADDR) )
      // Use Arduino RAM for stack/important stuff
      RAM[uP_ADDR - RAM_START] = DATA_IN;
    else
    // 6821?
    if ( KBD <=uP_ADDR && uP_ADDR <= DSPCR )
    {
      // KBD?
      if (uP_ADDR == KBD)
      {
        if (regKBDCR & 0x02)
          // KBD register
          {  
            regKBD = DATA_IN;
          }
        else
          regKBDDIR = DATA_IN;
      }
      else
      // KBDCR?
      if (uP_ADDR == KBDCR)
      {
        // KBDCR register
        regKBDCR = DATA_IN & 0X7F;  
      }
      else
      // DSP?
      if (uP_ADDR == DSP)
      {
        if (regDSPCR & 0x02)
          // DSP register
          if (DATA_IN == 0x8D)
            Serial.write("\r\n");    // send CR / LF
          else
            Serial.write(regDSP = DATA_IN & 0x7F);
        else
          regDSPDIR = DATA_IN;  
      }
      else
      // DSPCR?
      if (uP_ADDR == DSPCR)
      {
        // DSPCR register
        regDSPCR = DATA_IN;  
      }
    }
#if (USE_SPI_RAM)
    else
    {
      // treat everywhere else as ram
      cache_write_byte(uP_ADDR, DATA_IN);
      // spi_write_byte_quad(0, uP_ADDR, DATA_IN);
    }    
#endif

#if outputDEBUG
//    if (outputDEBUG)
//    {
      char tmp[20];
      sprintf(tmp, "WR A=%0.4X D=%0.2X\n", uP_ADDR, DATA_IN);
      Serial.write(tmp);
//    }
#endif
  }

  //////////////////////////////////////////////////////////////////
  // one full cycle complete
  clock_cycle_count ++;

  // start next cycle
  CLK_E_LOW;    // E goes low

  // natural delay for DATA Hold time (t_HR)
  DATA_DIR = DIR_IN;
}

////////////////////////////////////////////////////////////////////
// Serial Event
////////////////////////////////////////////////////////////////////

/*
  SerialEvent occurs whenever a new data comes in the
 hardware serial RX.  This routine is run between each
 time loop() runs, so using delay inside loop can delay
 response.  Multiple bytes of data may be available.
 */
inline __attribute__((always_inline))
void serialEvent0() 
{
  if (Serial.available())
    if ((regKBDCR & 0x80) == 0x00)      // read serial byte only if we can set 6821 interrupt
    {
      cli();                            // stop interrupts while changing 6821 guts.
      // 6821 portA is available      
      int ch = toupper( Serial.read() );    // apple1 expects upper case
      regKBD = ch | 0x80;               // apple1 expects bit 7 set for incoming characters.
      regKBDCR = regKBDCR | 0x80;       // set 6821 interrupt
      sei();
    }
  return;
}


////////////////////////////////////////////////////////////////////
// LCD/Keyboard functions
////////////////////////////////////////////////////////////////////

#if (USE_LCD_KEYPAD)

////////////////////////////////////////////////////////////////////
// int getKey() - LCD/Keyboard function from vendor
////////////////////////////////////////////////////////////////////

int getKey()
{
  key = get_key2();
  if (key != oldkey)
    {
      delay(BTN_DEBOUNCE);
      key = get_key2();
      if (key != oldkey) {
        oldkey = key;
        if (key == -1)
          BTN_RELEASE = 1;
        else
          BTN_PRESS = 1;
      }
    } else {
      BTN_PRESS = 0;
      BTN_RELEASE = 0;
    }
  return (key != -1);
}

int get_key2()
{
  int k;
  int adc_key_in;

  adc_key_in = analogRead( LCD_BTN );
  for( k = 0; k < NUM_KEYS; k++ )
  {
    if ( adc_key_in < adc_key_val[k] )
    {
      return k;
    }
  }
  if ( k >= NUM_KEYS )
    k = -1;
  return k;
}

////////////////////////////////////////////////////////////////////
// Button Press Callbacks - LCD/Keyboard function from vendor
////////////////////////////////////////////////////////////////////

void btn_Pressed_Select()
{
  // toggle LCD brightness
  analogWrite(LCD_BL, (backlightSet = (25 + backlightSet) % 100) );
}

void btn_Pressed_Left()
{
  // Serial.println("Left.");
  digitalWrite(uP_NMI_N, LOW);
}

void btn_Pressed_Right()
{
  // Serial.println("Right.");
  digitalWrite(uP_NMI_N, HIGH);
}

void btn_Pressed_Up()
{
  // Serial.println("Up.");
  
  // release uP_RESET
  digitalWrite(uP_RESET_N, HIGH);
}

void btn_Pressed_Down()
{
  // Serial.println("Down.");
  
  // assert uP_RESET
  digitalWrite(uP_RESET_N, LOW);
  
  // flush serial port
  while (Serial.available() > 0)
    Serial.read();
}

void process_lcdkeypad()
{
  // Handle key presses
  //
  if ( getKey() ) {
    // button pressed
    if ( BTN_PRESS ) {
      if (key == BTN_SELECT) btn_Pressed_Select();
      if (key == BTN_UP)     btn_Pressed_Up();
      if (key == BTN_DOWN)   btn_Pressed_Down();
      if (key == BTN_LEFT)   btn_Pressed_Left();
      if (key == BTN_RIGHT)  btn_Pressed_Right();      
    }
  } else
   // display processor info & performance
   // if (clock_cycle_count % 10 == 0) 
  {
    char tmp[20];
    float freq;
    
    lcd.setCursor(0, 0);
    // lcd.print(clock_cycle_count);
    sprintf(tmp, "A=%0.4X D=%0.2X", uP_ADDR, DATA_OUT);
    lcd.print(tmp);
    lcd.setCursor(0,1);
    
    freq = (float) (clock_cycle_count - clock_cycle_last) / (millis() - uP_millis_last + 1);
    lcd.print(freq);  lcd.print(" kHz   Z80");
    clock_cycle_last = clock_cycle_count;
    uP_millis_last = millis();
  }
}
#endif

////////////////////////////////////////////////////////////////////
// Setup
////////////////////////////////////////////////////////////////////

void setup() 
{
  Serial.begin(115200);

  Serial.write(27);       // ESC command
  Serial.print("[2J");    // clear screen command
  Serial.write(27);
  Serial.print("[H");
  Serial.println("\n");
  Serial.println("Configuration:");
  Serial.println("==============");
  Serial.print("Debug:      "); Serial.println(outputDEBUG, HEX);
  Serial.print("LCD-DISP:   "); Serial.println(USE_LCD_KEYPAD, HEX); 
  Serial.print("SPI-RAM:    "); Serial.print(USE_SPI_RAM * 65536, DEC); Serial.println(" Bytes");
  Serial.print("SRAM Size:  "); Serial.print(RAM_END - RAM_START + 1, DEC); Serial.println(" Bytes");
  Serial.print("SRAM_START: 0x"); Serial.println(RAM_START, HEX); 
  Serial.print("SRAM_END:   0x"); Serial.println(RAM_END, HEX); 

#if (USE_LCD_KEYPAD)
  {
    pinMode(LCD_BL, OUTPUT);
    analogWrite(LCD_BL, backlightSet);  
    lcd.begin(16, 2);
  }
#endif

#if (USE_SPI_RAM)
  // Initialize memory subsystem
  spi_init();
  cache_init();
#endif

  // Initialize processor GPIO's
  uP_init();
  m6821_init();
  
  // Reset processor for 25 cycles
  uP_assert_reset();
  for(int i=0; i<250; i++) cpu_tick();
  uP_release_reset();

  Serial.println("\n");
}


////////////////////////////////////////////////////////////////////
// Loop()
////////////////////////////////////////////////////////////////////

void loop()
{
  word i = 0;
  byte j = 0;
  
  // Loop forever
  //  
  while(1)
  {
    serialEvent0();
    cpu_tick();
    
    // delay(500);
    // execute lcdkeypad() when word i overflows (simple counter)
#if USE_LCD_KEYPAD
    if (i++ == 0) process_lcdkeypad();
#endif
  }
}
